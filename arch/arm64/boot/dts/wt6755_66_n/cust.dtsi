#include "cust_adc.dtsi"
#include "cust_clk_buf.dtsi"
#include "cust_eint.dtsi"
/*#include "cust_gpio.dtsi"*/
#include "cust_i2c.dtsi"
#include "cust_kpd.dtsi"
#include "cust_md1_eint.dtsi"
#include "cust_pmic.dtsi"


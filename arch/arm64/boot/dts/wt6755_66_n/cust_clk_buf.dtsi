/*
 * Generated by MTK SP DrvGen Version 03.13.6 for MT6755. Copyright MediaTek Inc. (C) 2013.
 * Mon Aug 12 22:58:53 2019
 * Do Not Modify the File.
 */

&rf_clock_buffer_ctrl {
	compatible = "mediatek, rf_clock_buffer";
	buffer1 = <2>;
	buffer2 = <0>;
	buffer3 = <1>;
	buffer4 = <1>;
	mediatek,clkbuf-driving-current=<2 2 2 2>;
};
&pmic_clock_buffer_ctrl {
	compatible = "mediatek, pmic_clock_buffer";
	buffer1 = <2>;
	buffer2 = <1>;
	buffer3 = <1>;
	buffer4 = <2>;
	mediatek,clkbuf-driving-current=<2 2 2 2>;
};
